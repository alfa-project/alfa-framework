## meta-alfa/conf/layer.conf
```bitbake
# We have a conf and classes directory, append to BBPATH
BBPATH .= ":${LAYERDIR}"

# We have a recipes directory, add to BBFILES
BBFILES += "${LAYERDIR}/recipes-*/*/*.bb \
	    ${LAYERDIR}/recipes-*/*/*.bbappend"

BBFILE_COLLECTIONS += "alfa-layer"
BBFILE_PATTERN_alfa-layer := "^${LAYERDIR}/"
BBFILE_PRIORITY_alfa-layer = "11"

LAYERVERSION_alfa-layer = "1"

LAYERDEPENDS_meta-alfa = "core"
LAYERSERIES_COMPAT_alfa-layer = "honister"
```
